/dts-v1/;
/plugin/;

/ {
    compatible = "arm";
    #address-cells = <1>;
    #size-cells = <1>;

    memory_log_1: memory@10000000 {
        compatible = "msft,memory-log";
        reg = <(0x10000000) (0x1000)>; /* address and size */
    };

    memory_log_2: memory@20000000 {
        compatible = "msft,memory-log";
        reg = <(0x20000000) (0x1000)>; /* address and size */
    };
};
